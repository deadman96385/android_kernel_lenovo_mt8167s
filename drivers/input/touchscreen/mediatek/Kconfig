## drivers/input/touchscreen/mediatek/Kconfig
```kconfig
#
# Touchscreen driver configuration
#
menuconfig INPUT_TOUCHSCREEN
	bool "Touchscreens"
	help
	  Say Y here, and a list of supported touchscreens will be displayed.
	  This option doesn't affect the kernel.

	  If unsure, say Y.

if INPUT_TOUCHSCREEN

config TOUCHSCREEN_MTK
	bool "MediaTek Touch Panel Driver"
	help
	  Say Y here if you have MediaTek touch panel.

	  If unsure, say N.

	  To compile this dirver as a module, choose M here: the
	  module will be called.

config TOUCHSCREEN_MTK_GT9XX
	bool "GOODIX_UPDATE_GT9XX for Mediatek package"
	default n
	help
	  Say Y here if you have GT9XX touch panel.

	  If unsure, say N.

	  To compile this dirver as a module, choose M here: the
	  module will be called.

source "drivers/input/touchscreen/mediatek/gt9xx_mtk/Kconfig

config TOUCHSCREEN_PHYSICAL_ROTATION_WITH_LCM
	bool "MediaTek Touch Panel Rotation With LCM"
	default y
	help
	  Say N here if touch panel is not physical rotated as LCM does.
	  Physically rotated means that this driver will map
	  the reported coordination to diagonal position.

	  If unsure, say Y.

config TOUCHSCREEN_MTK_GT1151
	bool "GT1151 for Mediatek package"
	default n
	help
	  Say Y here if you have GT1151 touch panel.

	  If unsure, say N.

	  To compile this dirver as a module, choose M here: the
	  module will be called.

source "drivers/input/touchscreen/mediatek/GT1151/Kconfig"

config TOUCHSCREEN_MTK_GT911
	bool "GT911 for Mediatek package"
	help
	  Say Y here if you have GT911 touch panel.

	  If unsure, say N.

source "drivers/input/touchscreen/mediatek/GT911/Kconfig"

config TOUCHSCREEN_MTK_FT3427
	bool "Focaltech FT3427 Ts for Mediatek package"
	help
	  Say Y here if you have FT3427 touch panel.

	  If unsure, say N.

config TOUCHSCREEN_MTK_FT6336
	bool "Focaltech FT6336 Ts for Mediatek package"
	depends on I2C
	help
	  Say Y here if you have FT6336 touch panel.
	  If unsure, say N.

config TOUCHSCREEN_MTK_GT9157
	bool "GT9157 for Mediatek package"
	help
	  Say Y here if you have GT9157 touch panel.
	  If unsure, say N.
	  To compile this dirver as a module, choose M here: the
	  module will be called

source "drivers/input/touchscreen/mediatek/GT9157/Kconfig"

config TOUCHSCREEN_FT5X26
	bool "FT5X26 for Mediatek package"
	default n
	help
	  Say Y here if you have FT5X26 touch panel.

	  If unsure, say N.

	  To compile this dirver as a module, choose M here: the
	  module will be called.

config TOUCHSCREEN_FT5X26_WUXGA
	bool "FT5X26 WUXGA for Mediatek package"
	default n
	help
	  Say Y here if you have FT5X26 touch panel.

	  If unsure, say N.

	  To compile this dirver as a module, choose M here: the
	  module will be called.

source "drivers/input/touchscreen/mediatek/FT5X26/Kconfig"

config TOUCHSCREEN_MTK_GSLX680
	bool "gslX680 for Mediatek package"
	help
	  Say Y here if you have gslX680 touch panel.

	  If unsure, say N.

config TOUCHSCREEN_MTK_GSL2338
	bool "gsl2338 for Mediatek package"
	help
	  Say Y here if you have gsl2338 touch panel.

	  If unsure, say N.
endif
```
