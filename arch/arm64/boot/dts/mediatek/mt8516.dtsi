/*
 * Mediatek's MT8516 SoC device tree source
 * Copyright (c) 2017 MediaTek Inc.
 *
 * This program is free software; you can redistribute it and/or modify
 * it under the terms of the GNU General Public License version 2 as
 * published by the Free Software Foundation.
 *
 * This program is distributed in the hope that it will be useful,
 * MERCHANTABILITY or FITNESS FOR A PARTICULAR PURPOSE.  See the
 * GNU General Public License for more details.
 */

#include "mt8167.dtsi"

&scpsys {
	compatible = "mediatek,mt8516-scpsys", "mediatek,mt8167-scpsys", "syscon";
};

&mfgcfg {
	compatible = "syscon";
	status = "disabled";
};

&mfg_async {
	status = "disabled";
};

&mfg_2d {
	status = "disabled";
};
